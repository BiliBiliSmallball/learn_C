/***************************************************************************
实验名称：	并行AD转换实验

实验模块：	STC8A核心板v2.1、主板区：12864图形液晶、并行A/D转换

实验接线：	STC8A核心板   -------------   12864图形液晶
							P2.0      -------------       CS1
							P2.1      -------------       CS2
							P2.2      -------------       RS
							P2.3      -------------       RW
							P2.4      -------------       RE		   
         P0.0~P0.7      -------------       DB0~DB7		
							
           STC8A核心板   -------------   并行A/D转换
				    P7.0~P7.7    -------------     D0~D7(J36)
				      P1.1       -------------	    CLKX2
							P6.0       -------------	    START
							P6.1       -------------	    EOC
							P6.2	     -------------	    OE
							P6.4	     -------------	    A
							P6.5	     -------------	    B
							P6.6	     -------------	    C
							P6.7	     -------------	    ALE
						
现象描述：	通过#define OPEN_CHL 选择输入通道，下载后将CH0连接STC8A的ADC接口，
			    转动STC8A的电位器改变输出电压，lcd2864显示连接通道采集的电压。

使用STC-ISP下载时请注意在【硬件选项】的第一项【输入用户程序运行是的IRC频率】
软件默认是11.0592MHz	但我们程序用的都是24MHz，所以我们需要手动输入或者下拉选择
24MHz然后再点击下载即可。然后即可看到右下方窗口提示
  . 用户设定频率: 24.000MHz
  . 调节后的频率: 24.000MHz
  . 频率调节误差: 0.000%
  
更新时间：2022.06.07
***************************************************************************/

#include <intrins.h>
#include "system.h"
#include "lcd12864.h"
#include "adc0809.h"
#include "pwm.h"
#include "stdio.h"

#define OPEN_CHL (IN0)	
//本实验开启1个通道,可根据需求增加或删减通道(浮空引脚电压约1.68)
//定义开启转换的通道最多8通道：( IN0 | IN1 | IN2 | IN3 | IN4 | IN5 | IN6 | IN7 )
								
void main(void)
{
	uint8_t sx = 0; 
	float vol = 0;
	int chl = 0;
	char show[17]={0};
	System_Init();						//系统初始化
	Pwm1_Configure();
	ADC0809_Hardware_Init();          	 //ADC初始化
  LCD12864_Software_Init();           //液晶初始化
    while(1)
	{
		sx = 0;
		//通道0到通道7循环采集电压
		for(chl=0;chl<8;chl++)
		{
			//判断是否为开启的通道
			if(OPEN_CHL&(1<<chl))
			{
				vol=ADC0809_Convert(chl)*5/255;
				sprintf(show,"CH:%2d  Vol:%3.1fV",chl,vol);
				Show_Num(0,sx%4,show);
				sx++;
				Delay_ms(500);
			}
		}
	}
}

//                                      endfile
